;************** TRABALHIN ZIKA (help) GGEZ *****************
LIST   P=PIC16F628A
RADIX DEC	
#INCLUDE <P16F628A.INC>
	__CONFIG H'3F10'

	CBLOCK	0x20	;ENDEREÇO INICIAL DA MEMÓRIA DE
					;USUÁRIO
	CONTADOR1
	CONTADOR2
	CONTADOR3

	ENDC			;FIM DO BLOCO DE MEMÓRIA	

	#DEFINE	BOTAO PORTA,2 ;PORTA DO BOTÃO
					  ; 0 -> PRESSIONADO
					  ; 1 -> LIBERADO

	#DEFINE	TERREO PORTB,0	;PORTA DO LED TERREO
					; 0 -> APAGADO
					; 1 -> ACESO	

	#DEFINE	PRIMEIRO PORTB,1	;PORTA DO LED PRIMEIRO ANDAR
					; 0 -> APAGADO
					; 1 -> ACESO	

	#DEFINE	SEGUNDO	PORTB,2	;PORTA DO LED SEGUNDO ANDAR
					; 0 -> APAGADO
					; 1 -> ACESO	

	#DEFINE	TERCEIRO PORTB,3	;PORTA DO LED TERCEIRO ANDAR
					; 0 -> APAGADO
					; 1 -> ACESO	

	#DEFINE	QUARTO PORTB,4	;PORTA DO LED QUARTO ANDAR
					; 0 -> APAGADO
					; 1 -> ACESO	

	#DEFINE	CONTROLE PORTB,5 ;PORTA DO LED CONTROLE
					; 0 -> APAGADO
					; 1 -> ACESO	
	
	ORG	0x00		;ENDEREÇO INICIAL DE PROCESSAMENTO
	GOTO	INICIO
		
INICIO
	CLRF	PORTA		;LIMPA O PORTA
	CLRF	PORTB		;LIMPA O PORTB
	BSF STATUS, RP0			;ALTERA PARA O BANCO 1
	MOVLW	B'00000100'
	MOVWF	TRISA		;DEFINE RA2 COMO ENTRADA E DEMAIS COMO SAÍDAS
	CLRF	TRISB		;DEFINE TODO O PORTB COMO SAÍDA
	CLRF	INTCON		;TODAS AS INTERRUPÇÕES DESLIGADAS
	BCF STATUS, RP0 ;RETORNA PARA O BANCO 0
	MOVLW	B'00000111'
	MOVWF	CMCON		;DEFINE O MODO DO COMPARADOR ANALÓGICO

;;ROTINA PRINCIPAL DO PROGRAMA
REPETE
	CALL TER
	NOP
	CALL PRIMEIROANDAR
	NOP
	CALL SEGUNDOANDAR
	NOP
	CALL TERCEIROANDAR
	NOP
	CALL QUARTOANDAR
	NOP
	CALL TERCEIROANDAR
	NOP
	CALL SEGUNDOANDAR
	NOP
	CALL PRIMEIROANDAR
	NOP
	CALL TER
	GOTO REPETE ;DELAY DE 1S

TER
	BSF TERREO
	BSF CONTROLE
	CALL ATRASO ;DELAY DE 1S
	BCF CONTROLE
	CALL ATRASO ;DELAY DE 1S
	BCF TERREO
	BSF CONTROLE
	RETURN

PRIMEIROANDAR
	BSF PRIMEIRO
	CALL ATRASO ;DELAY DE 1S
	BCF CONTROLE
	CALL ATRASO ;DELAY DE 1S
	BCF PRIMEIRO
	BSF CONTROLE
	BSF PRIMEIRO
	CALL ATRASO ;DELAY DE 1S
	BCF CONTROLE
	CALL ATRASO ;DELAY DE 1S
	BCF PRIMEIRO
	BSF CONTROLE
	RETURN

SEGUNDOANDAR
	BSF SEGUNDO
	CALL ATRASO ;DELAY DE 1S
	BCF CONTROLE
	CALL ATRASO ;DELAY DE 1S
	BCF SEGUNDO
	BSF CONTROLE
	BSF SEGUNDO
	CALL ATRASO ;DELAY DE 1S
	BCF CONTROLE
	CALL ATRASO ;DELAY DE 1S
	BCF SEGUNDO
	BSF CONTROLE
	BSF SEGUNDO
	CALL ATRASO ;DELAY DE 1S
	BCF CONTROLE
	CALL ATRASO ;DELAY DE 1S
	BCF SEGUNDO
	BSF CONTROLE
	RETURN

TERCEIROANDAR
	BSF TERCEIRO
	CALL ATRASO ;DELAY DE 1S
	BCF CONTROLE
	CALL ATRASO ;DELAY DE 1S
	BCF TERCEIRO
	BSF CONTROLE
	BSF TERCEIRO
	CALL ATRASO ;DELAY DE 1S
	BCF CONTROLE
	CALL ATRASO ;DELAY DE 1S
	BCF TERCEIRO
	BSF CONTROLE
	BSF TERCEIRO
	CALL ATRASO ;DELAY DE 1S
	BCF CONTROLE
	CALL ATRASO ;DELAY DE 1S
	BCF TERCEIRO
	BSF CONTROLE
	BSF TERCEIRO
	CALL ATRASO ;DELAY DE 1S
	BCF CONTROLE
	CALL ATRASO ;DELAY DE 1S
	BCF TERCEIRO
	BSF CONTROLE
	RETURN

QUARTOANDAR
	BSF QUARTO
	CALL ATRASO ;DELAY DE 1S
	BCF CONTROLE
	CALL ATRASO ;DELAY DE 1S
	BCF QUARTO
	BSF CONTROLE
	BSF QUARTO
	CALL ATRASO ;DELAY DE 1S
	BCF CONTROLE
	CALL ATRASO ;DELAY DE 1S
	BCF QUARTO
	BSF CONTROLE
	BSF QUARTO
	CALL ATRASO ;DELAY DE 1S
	BCF CONTROLE
	CALL ATRASO ;DELAY DE 1S
	BCF QUARTO
	BSF CONTROLE
	BSF QUARTO
	CALL ATRASO ;DELAY DE 1S
	BCF CONTROLE
	CALL ATRASO ;DELAY DE 1S
	BCF QUARTO
	BSF CONTROLE
	BSF QUARTO
	CALL ATRASO ;DELAY DE 1S
	BCF CONTROLE
	CALL ATRASO ;DELAY DE 1S
	BCF QUARTO
	BSF CONTROLE
	RETURN

ATRASO				
	MOVLW	54			;COLOCA 54 NO ACUMULADOR W
	MOVWF	CONTADOR1	;MOVE O VALOR DE w PARA DENTRO DE UM REGISTRADOR F
						;CONTADOR1 = 122

;PRIMEIRA FUNÇÃO DE ATRASO, COMO SE FOSSE O FOR MAIS EXTERNO
ATRASO1				
	MOVLW	52			;COLOCA 52 NO ACUMULADOR W	
	MOVWF	CONTADOR2	;MOVE O VALOR DE w PARA DENTRO DE UM REGISTRADOR F
	CALL 	ATRASO2		;CHAMA A SEGUNDA FUNÇÃO DE ATRASO
	
	DECFSZ	CONTADOR1	;LOOP DE 122 ATÉ 1
	GOTO	ATRASO1		 					
	
	RETURN				

;SEGUNDA FUNÇÃO DE ATRASO, COMO SE FOSSE O FOR DO MEIO
ATRASO2
	MOVLW	116		;COLOCA 116 NO ACUMULADOR W	
	MOVWF	CONTADOR3	;MOVE O VALOR DE w PARA DENTRO DE UM REGISTRADOR F
	CALL 	ATRASO3		;CHAMA A TERCEIRA FUNÇÃO DE ATRASO
	
	DECFSZ CONTADOR2	;LOOP DE 150 ATÉ 1
	GOTO ATRASO2
	CALL TESTA_BOTAO	

	RETURN

;TERCEIRA FUNÇÃO DE ATRASO, COMO SE FOSSE O FOR MAIS INTERNO
ATRASO3
	DECFSZ CONTADOR3	;LOOP DE 244 ATÉ 1
	GOTO ATRASO3
	
	RETURN

;FUNÇÃO QUE TESTA SE O BOTÃO ESTÁ PRESSIONADO
TESTA_BOTAO
	BTFSC	BOTAO		;O BOTÃO ESTÁ PRESSIONADO?
	RETURN	ATRASO3     ; NAO, ESPERA SER PRESSIONADO
	GOTO	BOTAO_PRESSIONADO	;SIM, ENTÃO TRATA BOTÃO PRESSIONADO
	
	RETURN ATRASO3

BOTAO_PRESSIONADO
	;ESPERA OS DOIS SEGUNDOS DO ANDAR
	;GOTO ATRASO
	;GOTO ATRASO
	;RETURN

END